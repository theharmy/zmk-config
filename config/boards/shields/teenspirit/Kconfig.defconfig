## config/boards/shields/twonr9/Kconfig.shield
```kconfig
config SHIELD_TWONR9_LEFT
    def_bool $(shields_list_contains,twonr9_left)

config SHIELD_TWONR9_RIGHT
    def_bool $(shields_list_contains,twonr9_right)
```

## config/boards/shields/twonr9_srht/Kconfig.shield
```kconfig
config SHIELD_TWONR9_SRHT_LEFT
    def_bool $(shields_list_contains,twonr9_srht_left)

config SHIELD_TWONR9_SRHT_RIGHT
    def_bool $(shields_list_contains,twonr9_srht_right)
```
