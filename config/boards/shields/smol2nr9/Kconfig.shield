## config/boards/shields/smol2nr9/Kconfig.shield
```kconfig
config SHIELD_SMOL2NR9_LEFT
    def_bool $(shields_list_contains,smol2nr9_left)

config SHIELD_SMOL2NR9_RIGHT
    def_bool $(shields_list_contains,smol2nr9_right)
```
