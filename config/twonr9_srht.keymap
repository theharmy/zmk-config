/*
 * TwoNr9 (18-Key Split Keyboard) Unified Keymap -- "srht" variant
 *
 * Built by the twonr9_srht_left / twonr9_srht_right shields, which pick this
 * file up by name. The default (bugwind) variant lives in twonr9.keymap and is
 * built by the plain twonr9_left / twonr9_right shields.
 *
 * Modular architecture:
 * - config/keys_de.h                  -> German keycodes (DE_*)
 * - config/twonr9_keys.h              -> Mod-morph pairs, magic shift, dual a2, smart space, smart num
 * - config/twonr9_adaptive_keys_srht.h -> Adaptive swap rules, their hold-taps & grid aliases
 * - config/twonr9_macros_srht.dtsi    -> German bigram digraph macros
 * - config/twonr9_combos_srht.dtsi    -> Bigram chords for this grid
 * - config/twonr9_combos.dtsi         -> Coding & utility combos (shared)
 * - config/symbol_work.dtsi           -> Diagonal symbol & German letter chords (shared, position-based)
 */

#include <behaviors.dtsi>
#include <dt-bindings/zmk/keys.h>
#include <dt-bindings/zmk/bt.h>
#include <dt-bindings/zmk/ext_power.h>
#include <dt-bindings/zmk/outputs.h>

#include "keys_de.h"

/* ==============================================================================
 * Global Behavior Settings & Tunings
 * ============================================================================== */

/* Quick-tap window, used ONLY by the hold-taps that have no require-prior-idle
 * gate: lt_spc, lt_dual, magic_shift and smart_num in twonr9_keys.h.
 *
 * Do not add this to the homerow mods, layer-taps or adaptive keys. Those all
 * set require-prior-idle-ms (HRM_IDLE / LT_IDLE = 300), and ZMK only evaluates
 * quick-tap-ms once that larger window has failed -- so any value <= 300 there
 * is unreachable. urob's timeless HRM omits quick-tap-ms for the same reason. */
#define QUICK_TAP_MS 175

/* Hold-tap tuning (single source of truth, used by the twonr9_*.h includes) */
#define HRM_TERM  280 // Homerow mods: tapping term
#define HRM_IDLE  300 // Homerow mods: require prior idle
#define LT_TERM   200 // Layer-taps: tapping term
#define LT_IDLE   300 // Layer-taps: require prior idle
#define AK_MS     300 // Adaptive keys: max prior idle for triggers

/* Combo window: every ZMK_COMBO that does not pass an explicit timeout uses
 * this (zmk-helpers' COMBO_TERM defaults to 30). Must be defined before the
 * helper include below. */
#define COMBO_TERM 35

#include "zmk-helpers/helper.h"


&sl { // Allow sticky mods to chord across sticky layers.
  ignore-modifiers;
};

/* ==============================================================================
 * Layer Definitions
 * ============================================================================== */

#define L_A1   0  // Base Alpha Layer 1
#define L_A2   1  // Secondary Alpha Layer 2
#define L_NAV  2  // Navigation & Editing
#define L_SYM  3  // Morphing Brackets & CS Symbols
#define L_FN   4  // Function Keys & Media
#define L_NUM  5  // 3x3 Right-Hand Numpad & Arithmetic

#define ALL 0 1 2 3 4 5

/* ==============================================================================
 * Matrix Geometry & Key Positions
 *
 *                     TwoNr9 KEY POSITIONS (18 Keys)
 *
 *              ╭──────┬──────┬──────╮      ╭──────┬──────┬──────╮
 *              │  0   │  1   │  2   │      │  3   │  4   │  5   │
 *       ╭──────┼──────┼──────┼──────┤      ├──────┼──────┼──────┼──────╮
 *       │  6   │  7   │  8   │  9   │      │  10  │  11  │  12  │  13  │
 *       ╰──────┴──────┼──────┼──────┤      ├──────┼──────┼──────┴──────╯
 *                     │  14  │  15  │      │  16  │  17  │
 *                     ╰──────┴──────╯      ╰──────┴──────╯
 * ============================================================================== */

#define KEYS_L   0 1 2 6 7 8 9
#define KEYS_R   3 4 5 10 11 12 13
#define THUMBS_L 14 15
#define THUMBS_R 16 17
#define THUMBS   THUMBS_L THUMBS_R

/* Hold-tap trigger sets: a key holds when its *other* hand (plus any thumb)
 * is chording. Named by the hand the key sits on, so TRIG_L is KEYS_R. */
#define TRIG_L   KEYS_R THUMBS // Trigger set for a key on the left hand
#define TRIG_R   KEYS_L THUMBS // Trigger set for a key on the right hand

#define XXX &none
#define ___ &trans

/* ==============================================================================
 * Custom Behaviors: Timeless Homerow Mods & Layer-Taps
 * ============================================================================== */

/* Timeless homerow mods, urob-style (see the cradio.keymap example in
 * modules/zmk/helpers): balanced flavour, 280ms tapping term, positional
 * hold-triggers limited to the opposite hand + thumbs, decided on release.
 *
 * quick-tap-ms is deliberately omitted, matching urob, and would be inert if
 * present: ZMK's is_quick_tap() only evaluates its same-key quick-tap branch
 * once require-prior-idle-ms has already failed, so with HRM_IDLE = 300 that
 * branch needs a value > 300 to ever be reachable. HRM_IDLE alone is the gate. */
#define MAKE_HRM(NAME, HOLD, TAP, TRIGGER_POS)                                 \
    ZMK_HOLD_TAP(NAME, bindings = <HOLD>, <TAP>; flavor = "balanced";          \
                 tapping-term-ms = <HRM_TERM>;                                 \
                 require-prior-idle-ms = <HRM_IDLE>; hold-trigger-on-release;  \
                 hold-trigger-key-positions = <TRIGGER_POS>;)

MAKE_HRM(hml, &kp, &kp, TRIG_L) // Left-hand Homerow Mods (hold when chording right-hand keys or thumbs).
MAKE_HRM(hmr, &kp, &kp, TRIG_R) // Right-hand Homerow Mods (hold when chording left-hand keys or thumbs).

&lt { // Layer-taps (overrides ZMK's built-in, urob-style): now on the top row.
    flavor = "balanced";
    tapping-term-ms = <LT_TERM>;
    // quick-tap-ms omitted: dead below LT_IDLE (300), see MAKE_HRM above.
    require-prior-idle-ms = <LT_IDLE>;
};

/* Include modular behaviors, macros, combos, and parameter macros */
#include "twonr9_keys.h"
#include "twonr9_adaptive_keys_srht.h"
#include "twonr9_macros_srht.dtsi"
#include "twonr9_combos.dtsi"       // shared utility/symbol/numpad combos
#include "twonr9_combos_srht.dtsi"   // srht bigram chords
#include "symbol_work.dtsi"


/* ==============================================================================
 * Layers
 * ============================================================================== */

ZMK_LAYER(a1,
//                         ╭─────────────────┬─────────────────┬─────────────────╮      ╭─────────────────┬─────────────────┬─────────────────╮
                            FN_L              &lt L_NAV DE_N    &lt L_SYM DE_D           &lt L_SYM DE_Y    NV_O              FN_U
//       ╭─────────────────┼─────────────────┼─────────────────┼─────────────────┤      ├─────────────────┼─────────────────┼─────────────────┼─────────────────┤
          &hml LCTRL DE_S   &hml LALT DE_R    GL_H              &hml LSHFT DE_T          &hmr RSHFT DE_C   &hmr RGUI DE_E    AR_I              &hmr RCTRL DE_A
//       ╰─────────────────┴─────────────────┴─────────────────┴─────────────────╯      ╰─────────────────┴─────────────────┴─────────────────┴─────────────────╯
                                              SMART_NUM         A2_DUAL                  SPC_NAV           SYM_DUAL
//                                           ╰─────────────────┴─────────────────╯      ╰─────────────────┴─────────────────╯
)

ZMK_LAYER(a2,
//                            ╭────────────────────┬────────────────────┬────────────────────╮      ╭────────────────────┬────────────────────┬────────────────────╮
                               FN_X                 NV_B                 SY_V                        &lt L_SYM DE_W       &lt L_NAV DE_Q       &lt L_FN DE_COMMA
//       ╭────────────────────┼────────────────────┼────────────────────┼────────────────────┤      ├────────────────────┼────────────────────┼────────────────────┼────────────────────┤
          &hml LCTRL DE_F      AL_M                 &hml LGUI DE_P       &hml LSHFT DE_K             &hmr RSHFT DE_G      &hmr RGUI DE_J       &hmr RALT DE_DOT     &hmr RCTRL DE_Z
//       ╰────────────────────┴────────────────────┴────────────────────┴────────────────────╯      ╰────────────────────┴────────────────────┴────────────────────┴────────────────────╯
                                                    SMART_NUM            &to L_A1                    SPC_NAV              SYM_DUAL
//                                                 ╰────────────────────┴────────────────────╯      ╰────────────────────┴────────────────────╯
)

ZMK_LAYER(nav,
//              ╭────────┬────────┬────────╮      ╭────────┬────────┬────────╮
                  &sk LALT &sk LGUI &sk LSHFT       NAV_LEFT NAV_DOWN NAV_UP
//       ╭──────┼────────┼────────┼────────┤      ├────────┼────────┼────────┼────────╮
           &sk LCTRL &kp LG(DE_Q) &kp LG(TAB) &niri_adjust &swapper NAV_PGDN NAV_PGUP NAV_RIGHT
//       ╰──────┴────────┼────────┼────────┤      ├────────┼────────┼────────┴────────╯
                         SMART_NUM  &to L_A1           SPC_NAV   SYM_DUAL
//                     ╰─────────┴─────────╯      ╰───────────┴─────────╯
)

ZMK_LAYER(sym,
//              ╭───────────┬───────────┬───────────╮      ╭────────┬────────┬────────────╮
                  &excl_qmark &hash_tilde &dllr_euro         &lpar_rpar &lbkt_rbkt &semi_sqt
//       ╭──────┼───────────┼───────────┼───────────┤      ├────────┼────────┼────────────┼──────────╮
            &grave_caret &under_minus &amps_at &equal_pipe  &lbrc_rbrc &lt_gt &colon_dqt &fslh_bslh
//       ╰──────┴───────────┼───────────┼───────────┤      ├────────┼────────┼────────────┴──────────╯
                         SMART_NUM  &to L_A1           SPC_NAV   SYM_DUAL
//                        ╰───────────┴───────────╯      ╰───────────┴─────────╯
)

ZMK_LAYER(fn,
//              ╭──────┬──────┬──────╮      ╭──────┬──────┬──────╮
                  &kp F1 &kp F2 &kp F3        &kp F8 &kp F9 &kp F10
//       ╭──────┼──────┼──────┼──────┤      ├──────┼──────┼──────┼──────╮
           &kp F4 &kp F5 &kp F6 &kp F7        &kp F11 &kp F12 &kp C_VOL_DN &kp C_VOL_UP
//       ╰──────┴──────┼──────┼──────┤      ├──────┼──────┼──────┴──────╯
                         SMART_NUM  &to L_A1           SPC_NAV   SYM_DUAL
//                     ╰──────┴──────╯      ╰───────────┴─────────╯
)

ZMK_LAYER(num,
//              ╭────────────┬────────────┬────────────╮      ╭────────┬────────┬────────╮
                  &kp DE_MINUS &kp DE_ASTRK &kp DE_EQUAL        &kp DE_N4 &kp DE_N5 &kp DE_N6
//       ╭──────┼────────────┼────────────┼────────────┤      ├────────┼────────┼────────┼──────╮
           &kp DE_PLUS &kp DE_PRCNT &kp DE_FSLH &dot_comma      &kp DE_N1 &kp DE_N2 &kp DE_N3 &kp DE_N0
//       ╰──────┴────────────┼────────────┼────────────┤      ├────────┼────────┼────────┴──────╯
                         SMART_NUM  &to L_A1           SPC_NAV   SYM_DUAL
//                           ╰────────────┴────────────╯        ╰───────────┴─────────╯
)
